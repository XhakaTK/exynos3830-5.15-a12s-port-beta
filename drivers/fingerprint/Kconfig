## drivers/fingerprint/Kconfig
```kconfig
#
# Fingerprint sensor drivers configuration
#
menuconfig SENSORS_FINGERPRINT
	tristate "Finger Print Sensor devices"
	help
	  Say Y here, and a list of fingerprint sensor drivers will be displayed.
	  This option doesn't affect the kernel.
	  If unsure, say Y.

config FINGERPRINT_SECURE
	tristate "fingerprint sensor support"
	default n
	depends on SENSORS_FINGERPRINT
	help
	  If you say yes here you get support for Trustzone.

config SENSORS_FINGERPRINT_LSI
	tristate "System LSI AP support"
	default n
	depends on SENSORS_FINGERPRINT
	help
	  If you say yes here you get support for System LSI AP.

config SENSORS_ET5XX
	tristate "ET5XX fingerprint sensor support"
	default n
	depends on SENSORS_FINGERPRINT
	help
	  Fingerprint sensor driver.
	  If you say yes here you get support for ET5XX sensor.
	  ET5XX is the touch type fingerprint sensor.
	  ET5XX module can support WOF mode.
```
